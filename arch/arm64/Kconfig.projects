## arch/arm64/Kconfig.projects
```kconfig
config SEC_Y2Q_PROJECT
	depends on ARCH_KONA
	default n
	bool "Samsung Y2Q Project"
	help
	  Support for Samsung Y2Q Project

config MACH_Y2Q_JPN_SINGLE
	depends on SEC_Y2Q_PROJECT
	default n
	bool "Samsung Y2Q JPN SINGLE"
	help
	  Support for Samsung Y2Q JPN SINGLE device.

config MACH_Y2Q_JPN_DCMOLY
	default n
	bool "Samsung Y2Q JPN OLY DCMOLY"
	help
	  Support for Samsung Y2Q JPN DCMOLY device.

config SEC_GTS7XL_PROJECT
        default n
        bool "Samsung GTS7XL Project"
        help
          Support for Samsung GTS7XL Project

config MACH_GTS7XL_EUR_OPEN
        default n
        bool "Samsung GTS7XL EUR OPEN"
        help
          Support for Samsung GTS7XL EUR OPEN device.

config MACH_GTS7XLWIFI_EUR_OPEN
        default n
        bool "Samsung GTS7XLWIFI EUR OPEN"
        help
          Support for Samsung GTS7XLWIFI EUR OPEN device.
```
